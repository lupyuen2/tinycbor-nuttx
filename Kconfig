## Kconfig
```kconfig
#
# For a description of the syntax of this configuration file,
# see the file kconfig-language.txt in the NuttX tools repository.
#

menuconfig LIBTINYCBOR
	bool "TinyCBOR Library"
	default n
	---help---
		Enable build for TinyCBOR library

if LIBTINYCBOR

config LIBTINYCBOR_DEBUG
	bool "TinyCBOR debugging"
	default n
	---help---
		Enable debugging for TinyCBOR library

endif # LIBTINYCBOR
```
